## conf/layer.conf
```bitbake
# We have a conf and classes directory, add to BBPATH
BBPATH .= ":${LAYERDIR}"

# We have recipes-* directories, add to BBFILES
BBFILES += "${LAYERDIR}/recipes-*/*/*.bb \
            ${LAYERDIR}/recipes-*/*/*.bbappend"

BBFILE_COLLECTIONS += "meta-mrobot"
BBFILE_PATTERN_meta-mrobot = "^${LAYERDIR}/"
BBFILE_PRIORITY_meta-mrobot = "10"

LAYERDEPENDS_meta-mrobot = "core"
LAYERSERIES_COMPAT_meta-mrobot = "mickledore"

ENABLE_UART = "1"
VIDEO_CAMERA = "1"
LICENSE_FLAGS_ACCEPTED += "synaptics-killswitch commercial"
GPU_MEM_512="256"

DISTRO_FEATURES += " wifi bluetooth systemd"
VIRTUAL-RUNTIME_init_manager = "systemd"
VIRTUAL-RUNTIME_initscripts = ""
```
